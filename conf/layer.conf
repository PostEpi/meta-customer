## conf/layer.conf
```bitbake
# We have a conf and classes directory, add to BBPATH
BBPATH .= ":${LAYERDIR}"

# We have recipes-* directories, add to BBFILES
BBFILES += "${LAYERDIR}/recipes-*/*/*.bb \
            ${LAYERDIR}/recipes-*/*/*.bbappend"

BBFILE_COLLECTIONS += "../../meta-customer"
BBFILE_PATTERN_../../meta-customer = "^${LAYERDIR}/"
BBFILE_PRIORITY_../../meta-customer = "6"
```
